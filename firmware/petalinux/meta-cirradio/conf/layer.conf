## firmware/petalinux/meta-cirradio/conf/layer.conf
```bitbake
BBPATH .= ":${LAYERDIR}"
BBFILES += "${LAYERDIR}/recipes-*/*/*.bb"
BBFILE_COLLECTIONS += "cirradio"
BBFILE_PATTERN_cirradio = "^${LAYERDIR}/"
BBFILE_PRIORITY_cirradio = "6"
LAYERDEPENDS_cirradio = "core"
LAYERSERIES_COMPAT_cirradio = "scarthgap"

IMAGE_INSTALL_append = " ima-policy dm-verity-rootfs cirradio-seccomp"
```
